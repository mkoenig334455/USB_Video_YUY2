/* USER CODE BEGIN Header */
/**
  ******************************************************************************
  * @file           : main.c
  * @brief          : Main program body
  ******************************************************************************
  * @attention
  *
  * Copyright (c) 2024 STMicroelectronics.
  * All rights reserved.
  *
  * This software is licensed under terms that can be found in the LICENSE file
  * in the root directory of this software component.
  * If no LICENSE file comes with this software, it is provided AS-IS.
  *
  ******************************************************************************
  */
/* USER CODE END Header */
/* Includes ------------------------------------------------------------------*/
#include "main.h"
#include "usb_otg.h"
#include "gpio.h"

/* Private includes ----------------------------------------------------------*/
/* USER CODE BEGIN Includes */
#include "usbd_composite.h"//user modify
#include "usbd_video.h"

/* USER CODE END Includes */

/* Private typedef -----------------------------------------------------------*/
/* USER CODE BEGIN PTD */

/* USER CODE END PTD */

/* Private define ------------------------------------------------------------*/
/* USER CODE BEGIN PD */

/* USER CODE END PD */

/* Private macro -------------------------------------------------------------*/
/* USER CODE BEGIN PM */

/* USER CODE END PM */

/* Private variables ---------------------------------------------------------*/

/* USER CODE BEGIN PV */

/* USER CODE END PV */

/* Private function prototypes -----------------------------------------------*/
void SystemClock_Config(void);
/* USER CODE BEGIN PFP */
int8_t bTerminalConnect;
uint8_t img_count;

extern USBD_HandleTypeDef hUsbDevice;
extern void MX_USB_DEVICE_Init(void);

#ifdef USBD_UVC_FORMAT_UNCOMPRESSED
#define IMAGE1_SIZE  	UVC_WIDTH*UVC_HEIGHT*2
#define IMAGE2_SIZE		UVC_WIDTH*UVC_HEIGHT*2

#else
#define IMAGE1_SIZE  	4518
#define IMAGE2_SIZE		4474
#endif


#ifdef USBD_UVC_FORMAT_UNCOMPRESSED
const  uint8_t image1[IMAGE1_SIZE] = {
		 0xFF, 0xFF, 0xFF, 0xFF, 0xFF, 0xFF, 0xFF, 0xFF, 0xFF, 0xFF, 0xFF, 0xFF, 0xFF, 0xFF, 0xFF, 0xFF, 0xFF, 0xFF, 0xFF, 0xFF,
		 0xFF, 0xFF, 0xFF, 0xFF, 0xFF, 0xFF, 0xFF, 0xFF, 0xFF, 0xFF, 0xFF, 0xFF, 0xFF, 0xFF, 0xFF, 0xFF, 0xFF, 0xFF, 0xFF, 0xFF,
		 0xFF, 0xFF, 0xFF, 0xFF, 0xFF, 0xFF, 0xFF, 0xFF, 0xFF, 0xFF, 0xFF, 0xFF, 0xFF, 0xFF, 0xFF, 0xFF, 0xFF, 0xFF, 0xFF, 0xFF,
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		 0xFF, 0xFF, 0xFF, 0xFF, 0xFF, 0xFF, 0xFF, 0xFF, 0xFF, 0xFF, 0xFF, 0xFF, 0xFF, 0xFF, 0xFF, 0xFF, 0xFF, 0xFF, 0xFF, 0xFF,
		};
const  uint8_t image2[IMAGE1_SIZE]= {
		 0x51, 0x51, 0x51, 0x51, 0x51, 0x51, 0x51, 0x51, 0x51, 0x51, 0x51, 0x51, 0x51, 0x51, 0x51, 0x51, 0x51, 0x51, 0x51, 0x51,
		 0x51, 0x51, 0x51, 0x51, 0x51, 0x51, 0x51, 0x51, 0x51, 0x51, 0x51, 0x51, 0x51, 0x51, 0x51, 0x51, 0x51, 0x51, 0x51, 0x51,
		 0x51, 0x51, 0x51, 0x51, 0x51, 0x51, 0x51, 0x51, 0x51, 0x51, 0x51, 0x51, 0x51, 0x51, 0x51, 0x51, 0x51, 0x51, 0x51, 0x51,
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		 0x51, 0x51, 0x51, 0x51, 0x51, 0x51, 0x51, 0x51, 0x51, 0x51, 0x51, 0x51, 0x51, 0x51, 0x51, 0x51, 0x51, 0x51, 0x51, 0x51,
		};

#else

const  uint8_t image1[IMAGE1_SIZE] = {

/* Video Frame 1 */
0xFF,0xD8,0xFF,0xE0,0x00,0x21,0x41,0x56,
0x49,0x31,0x00,0x01,0x01,0x01,0x00,0x78,
0x00,0x78,0x00,0x00,0x00,0x00,0x00,0x00,
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0x0A,0xA4,0xC1,0x1F,0xFF,0xD9
};




const  uint8_t image2[IMAGE2_SIZE] = {

/* Video Frame 2 */
0xFF,0xD8,0xFF,0xE0,0x00,0x21,0x41,0x56,
0x49,0x31,0x00,0x01,0x01,0x01,0x00,0x78,
0x00,0x78,0x00,0x00,0x00,0x00,0x00,0x00,
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0x53,0xB6,0x83,0x4C,0xFF,0xD9
};



#endif



const  uint8_t *tImagesList[] = {image1, image2};
uint16_t tImagesSizes[] = {IMAGE1_SIZE, IMAGE2_SIZE};



/* USER CODE END PFP */

/* Private user code ---------------------------------------------------------*/
/* USER CODE BEGIN 0 */



#define IMG_NBR                   2U
#define USE_USB_HS 1



 int8_t VIDEO_Itf_Data(uint8_t **pbuf, uint16_t *psize, uint16_t *pcktidx)
{
  /*
    Implementation of this function is mandatory to provide the video data to the USB video class
    This function shall parse the MJPEG images and provide each time the buffer packet relative to
    current packet index and its size.
    If the packet is the first packet in the current MJPEG image, then packet size shall be zero and
    the pbuf is ignored and pcktidx shall be zero.
    Below is typical implementation of this function based on a binary image template.

    Binary image template shall provide:
     - tImagesList: table containing pointers to all images
     - tImagesSizes: table containing sizes of each image respectively
     - img_count: global image counter variable
     - IMG_NBR: Total image number

     To generate such file, it is possible to use tools converting video to MJPEG then to JPEG images.

  */



#ifdef USBD_UVC_FORMAT_UNCOMPRESSED
	  const uint8_t *(*ImagePtr) = tImagesList;
	  uint32_t packet_count = (tImagesSizes[img_count]) / ((UVC_PACKET_SIZE - (UVC_HEADER_PACKET_CNT * 2U)));
	  uint32_t packet_remainder = (tImagesSizes[img_count]) % ((UVC_PACKET_SIZE - (UVC_HEADER_PACKET_CNT * 2U)));
	  static uint8_t packet_index = 0U;

	  /* Check if end of current image has been reached */
	  if (packet_index < packet_count)
	  {
	    /* Set the current packet size */
	    *psize = (uint16_t)UVC_PACKET_SIZE;

	    /* Get the pointer to the next packet to be transmitted */
	    *pbuf = (uint8_t *)(*(ImagePtr + img_count) + \
	                        (packet_index * ((uint16_t)(UVC_PACKET_SIZE - (UVC_HEADER_PACKET_CNT * 2U)))));
	  }
	  else if ((packet_index == packet_count))
	  {
	    if (packet_remainder != 0U)
	    {
	      /* Get the pointer to the next packet to be transmitted */
	      *pbuf = (uint8_t *)(*(ImagePtr + img_count) + \
	                          (packet_index * ((uint16_t)(UVC_PACKET_SIZE - (UVC_HEADER_PACKET_CNT * 2U)))));

	      /* Set the current packet size */
	      *psize = (uint16_t)(packet_remainder + (UVC_HEADER_PACKET_CNT * 2U));
	    }
	    else
	    {
	      packet_index++;

	      /* New image to be started, send only the packet header */
	      *psize = 2;
	    }
	  }
	  else
	  {
	    /* New image to be started, send only the packet header */
	    *psize = 2;
	  }

	  /* Update the packet index */
	  *pcktidx = packet_index;

	  /* Increment the packet count and check if it reached the end of current image buffer */
	  if (packet_index++ >= (packet_count + 1U))
	  {
	    /* Reset the packet count to zero */
	    packet_index = 0U;

	    /* Move to the next image in the images table */

	    img_count++;

	    /* Check if images count has been reached, then reset to zero (go back to first image in circular loop) */
	    if (img_count == IMG_NBR)
	    {
	      img_count = 0U;
	    }
	  }




#else
  const uint8_t *(*ImagePtr) = tImagesList;
  uint32_t packet_count = (tImagesSizes[img_count]) / ((UVC_PACKET_SIZE - (UVC_HEADER_PACKET_CNT * 2U)));
  uint32_t packet_remainder = (tImagesSizes[img_count]) % ((UVC_PACKET_SIZE - (UVC_HEADER_PACKET_CNT * 2U)));
  static uint8_t packet_index = 0U;

  /* Check if end of current image has been reached */
  if (packet_index < packet_count)
  {
    /* Set the current packet size */
    *psize = (uint16_t)UVC_PACKET_SIZE;

    /* Get the pointer to the next packet to be transmitted */
    *pbuf = (uint8_t *)(*(ImagePtr + img_count) + \
                        (packet_index * ((uint16_t)(UVC_PACKET_SIZE - (UVC_HEADER_PACKET_CNT * 2U)))));
  }
  else if ((packet_index == packet_count))
  {
    if (packet_remainder != 0U)
    {
      /* Get the pointer to the next packet to be transmitted */
      *pbuf = (uint8_t *)(*(ImagePtr + img_count) + \
                          (packet_index * ((uint16_t)(UVC_PACKET_SIZE - (UVC_HEADER_PACKET_CNT * 2U)))));

      /* Set the current packet size */
      *psize = (uint16_t)(packet_remainder + (UVC_HEADER_PACKET_CNT * 2U));
    }
    else
    {
      packet_index++;

      /* New image to be started, send only the packet header */
      *psize = 2;
    }
  }
  else
  {
    /* New image to be started, send only the packet header */
    *psize = 2;
  }

  /* Update the packet index */
  *pcktidx = packet_index;

  /* Increment the packet count and check if it reached the end of current image buffer */
  if (packet_index++ >= (packet_count + 1U))
  {
    /* Reset the packet count to zero */
    packet_index = 0U;

    /* Move to the next image in the images table */

    img_count++;

    /* Check if images count has been reached, then reset to zero (go back to first image in circular loop) */
    if (img_count == IMG_NBR)
    {
      img_count = 0U;
    }
  }

#endif
    return (0);
}




 uint8_t restartusb;

/* USER CODE END 0 */

/**
  * @brief  The application entry point.
  * @retval int
  */
int main(void)
{
  /* USER CODE BEGIN 1 */
  /* USER CODE END 1 */

  /* MCU Configuration--------------------------------------------------------*/

  /* Reset of all peripherals, Initializes the Flash interface and the Systick. */
  HAL_Init();

  /* USER CODE BEGIN Init */

  /* USER CODE END Init */

  /* Configure the system clock */
  SystemClock_Config();

  /* USER CODE BEGIN SysInit */

  /* USER CODE END SysInit */

  /* Initialize all configured peripherals */
  MX_GPIO_Init();
  MX_USB_OTG_HS_PCD_Init();
  /* USER CODE BEGIN 2 */
  MX_USB_DEVICE_Init();//user modify

  /* USER CODE END 2 */

  /* Infinite loop */
  /* USER CODE BEGIN WHILE */
  while (1)
  {
    /* USER CODE END WHILE */

    /* USER CODE BEGIN 3 */
  }
  /* USER CODE END 3 */
}

/**
  * @brief System Clock Configuration
  * @retval None
  */
void SystemClock_Config(void)
{
  RCC_OscInitTypeDef RCC_OscInitStruct = {0};
  RCC_ClkInitTypeDef RCC_ClkInitStruct = {0};

  /** Configure the main internal regulator output voltage
  */
  __HAL_RCC_PWR_CLK_ENABLE();
  __HAL_PWR_VOLTAGESCALING_CONFIG(PWR_REGULATOR_VOLTAGE_SCALE1);

  /** Initializes the RCC Oscillators according to the specified parameters
  * in the RCC_OscInitTypeDef structure.
  */
  RCC_OscInitStruct.OscillatorType = RCC_OSCILLATORTYPE_HSI|RCC_OSCILLATORTYPE_HSE;
  RCC_OscInitStruct.HSEState = RCC_HSE_ON;
  RCC_OscInitStruct.HSIState = RCC_HSI_ON;
  RCC_OscInitStruct.HSICalibrationValue = RCC_HSICALIBRATION_DEFAULT;
  RCC_OscInitStruct.PLL.PLLState = RCC_PLL_ON;
  RCC_OscInitStruct.PLL.PLLSource = RCC_PLLSOURCE_HSI;
  RCC_OscInitStruct.PLL.PLLM = 8;
  RCC_OscInitStruct.PLL.PLLN = 168;
  RCC_OscInitStruct.PLL.PLLP = RCC_PLLP_DIV2;
  RCC_OscInitStruct.PLL.PLLQ = 4;
  if (HAL_RCC_OscConfig(&RCC_OscInitStruct) != HAL_OK)
  {
    Error_Handler();
  }

  /** Initializes the CPU, AHB and APB buses clocks
  */
  RCC_ClkInitStruct.ClockType = RCC_CLOCKTYPE_HCLK|RCC_CLOCKTYPE_SYSCLK
                              |RCC_CLOCKTYPE_PCLK1|RCC_CLOCKTYPE_PCLK2;
  RCC_ClkInitStruct.SYSCLKSource = RCC_SYSCLKSOURCE_PLLCLK;
  RCC_ClkInitStruct.AHBCLKDivider = RCC_SYSCLK_DIV1;
  RCC_ClkInitStruct.APB1CLKDivider = RCC_HCLK_DIV4;
  RCC_ClkInitStruct.APB2CLKDivider = RCC_HCLK_DIV2;

  if (HAL_RCC_ClockConfig(&RCC_ClkInitStruct, FLASH_LATENCY_5) != HAL_OK)
  {
    Error_Handler();
  }
  HAL_RCC_MCOConfig(RCC_MCO1, RCC_MCO1SOURCE_HSE, RCC_MCODIV_1);
}

/* USER CODE BEGIN 4 */

/* USER CODE END 4 */

/**
  * @brief  This function is executed in case of error occurrence.
  * @retval None
  */
void Error_Handler(void)
{
  /* USER CODE BEGIN Error_Handler_Debug */
  /* User can add his own implementation to report the HAL error return state */
  __disable_irq();
  while (1)
  {
  }
  /* USER CODE END Error_Handler_Debug */
}

#ifdef  USE_FULL_ASSERT
/**
  * @brief  Reports the name of the source file and the source line number
  *         where the assert_param error has occurred.
  * @param  file: pointer to the source file name
  * @param  line: assert_param error line source number
  * @retval None
  */
void assert_failed(uint8_t *file, uint32_t line)
{
  /* USER CODE BEGIN 6 */
  /* User can add his own implementation to report the file name and line number,
     ex: printf("Wrong parameters value: file %s on line %d\r\n", file, line) */
  /* USER CODE END 6 */
}
#endif /* USE_FULL_ASSERT */
